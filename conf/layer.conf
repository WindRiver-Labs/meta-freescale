## conf/layer.conf
```bitbake
# We have a conf and classes directory, add to BBPATH
BBPATH .= ":${LAYERDIR}"

# We have a packages directory, add to BBFILES
BBFILES += "${@bb.utils.contains_any('MACHINE', 'nxp-ls20xx', '${LAYERDIR}/recipes-*/*/*.bb', '', d)}"
BBFILES += "${@bb.utils.contains_any('MACHINE', 'nxp-ls20xx', '${LAYERDIR}/recipes-*/*/*.bbappend', '', d)}"

BBFILES += "${@bb.utils.contains_any('BBFILE_COLLECTIONS', 'imx6-graphic-layer', '${LAYERDIR}/recipes-graphics/*/*.bb', '', d)}"
BBFILES += "${@bb.utils.contains_any('BBFILE_COLLECTIONS', 'imx6-graphic-layer', '${LAYERDIR}/recipes-graphics/*/*.bbappend', '', d)}"
BBFILES += "${@bb.utils.contains_any('BBFILE_COLLECTIONS', 'imx6-graphic-layer', '${LAYERDIR}/recipes-bsp/*/*.bb', '', d)}"
BBFILES += "${@bb.utils.contains_any('BBFILE_COLLECTIONS', 'imx6-graphic-layer', '${LAYERDIR}/recipes-bsp/*/*.bbappend', '', d)}"

BBFILE_COLLECTIONS += "freescale-layer"
BBFILE_PATTERN_freescale-layer := "^${LAYERDIR}/"
BBFILE_PRIORITY_freescale-layer = "5"

LAYERDEPENDS_freescale-layer = "core"
LAYERRECOMMENDS_freescale-layer = "meta-freescale-dl"

# Add the Freescale-specific licenses into the metadata
LICENSE_PATH += "${LAYERDIR}/custom-licenses"

FSL_EULA_FILE = "${LAYERDIR}/EULA"

IMX_MIRROR ?= "http://www.freescale.com/lgfiles/NMG/MAD/YOCTO/"
QORIQ_MIRROR ?= "http://git.freescale.com/source/"

# FIXME: set this to avoid changing all the recipes that use it
FSL_MIRROR ?= "${IMX_MIRROR}"

MIRRORS += " \
${IMX_MIRROR}   http://download.ossystems.com.br/bsp/freescale/source/ \n \
${QORIQ_MIRROR} http://download.ossystems.com.br/bsp/freescale/source/ \n \
"

# The dynamic-layers directory hosts the extensions and layer specific
# modifications related to Freescale products.
#
# The .bbappend and .bb files are included if the respective layer
# collection is available.
BBFILES += "${@' '.join('${LAYERDIR}/dynamic-layers/%s/recipes*/*/*.bbappend' % layer \
               for layer in BBFILE_COLLECTIONS.split())}"
BBFILES += "${@' '.join('${LAYERDIR}/dynamic-layers/%s/recipes*/*/*.bb' % layer \
               for layer in BBFILE_COLLECTIONS.split())}"
```
